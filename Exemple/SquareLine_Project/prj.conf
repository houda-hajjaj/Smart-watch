## CMakeLists.txt
```
# Copyright (c)  2024 LVGL <felipe@lvgl.io>
# SPDX-License-Identifier: Apache-2.0

cmake_minimum_required(VERSION 3.20.0)

set(SHIELD adafruit_2_8_tft_touch_v2)

find_package(Zephyr REQUIRED HINTS $ENV{ZEPHYR_BASE})
project(SquareLine_Project)

set(LVGL_DIR ${ZEPHYR_LVGL_MODULE_DIR})

FILE(GLOB app_sources src/sensor/*.c src/*.c src/ui/*.c src/ui/images/*.c src/ui/fonts/*.c src/ui/screens/*.c src/ui/components/*.c)
target_sources(app PRIVATE ${app_sources})


if(CONFIG_DT_HAS_TI_TSC2007_ENABLED)
    target_sources(app PRIVATE ${ZEPHYR_BASE}/drivers/input/input_tsc2007.c)
endif()
```

## prj.conf
```kconfig
CONFIG_MAIN_STACK_SIZE=8192
CONFIG_LOG=y
CONFIG_SHELL=y

CONFIG_LVGL=y
CONFIG_LV_Z_MEM_POOL_SIZE=32768
CONFIG_LV_Z_SHELL=y
CONFIG_LV_USE_MONKEY=y
CONFIG_LV_COLOR_DEPTH_32=y

CONFIG_DISPLAY=y
CONFIG_INPUT=y
CONFIG_SENSOR=y

CONFIG_LV_USE_PERF_MONITOR=y

CONFIG_LV_FONT_MONTSERRAT_16=y
CONFIG_LV_FONT_MONTSERRAT_18=y
CONFIG_LV_FONT_MONTSERRAT_20=y
CONFIG_LV_FONT_MONTSERRAT_24=y

# Benchmark Demo
CONFIG_LV_USE_FONT_COMPRESSED=y
```

## src/main.c
```c
/*
 * Copyright (c) 2024 LVGL <felipe@lvgl.io>
 *
 * SPDX-License-Identifier: Apache-2.0
 */

#include <zephyr/kernel.h>
#include <zephyr/drivers/display.h>
#include <lvgl.h>
#include <lvgl_mem.h>
//#include <lv_demos.h>
#include "ui/ui.h"
#include "sensor/env_sensor.h"
#include <stdio.h>
#include <stdlib.h>

EnvSensor g_sensor;

static void sensor_update_cb(lv_timer_t *timer)
{
	char buf[16];
	if (env_update(&g_sensor) == 0) {
		snprintf(buf, sizeof(buf), "%d.%d",
			g_sensor.temp_hts.val1,
			abs(g_sensor.temp_hts.val2) / 100000);
		lv_label_set_text(ui_Label2, buf);
	}
}

#define LOG_LEVEL CONFIG_LOG_DEFAULT_LEVEL
#include <zephyr/logging/log.h>
LOG_MODULE_REGISTER(app);

int main(void)
{
	const struct device *display_dev;

	display_dev = DEVICE_DT_GET(DT_CHOSEN(zephyr_display));
	if (!device_is_ready(display_dev)) {
		LOG_ERR("Device not ready, aborting test");
		return 0;
	}

	/* Place your UI init function here */
	ui_init();

	if (env_init(&g_sensor) == 0) {
		lv_timer_create(sensor_update_cb, 1000, NULL);
	} else {
		LOG_ERR("Sensor init failed");
	}

	display_blanking_off(display_dev);
#ifdef CONFIG_LV_Z_MEM_POOL_SYS_HEAP
	lvgl_print_heap_info(false);
#else
	printf("lvgl in malloc mode\n");
#endif
	while (1) {
	        //This function has to be called periodically to update the UI
	        //Can be placed in a dedicated thread
		uint32_t sleep_ms = lv_timer_handler();
		k_msleep(MIN(sleep_ms, INT32_MAX));
	}

	return 0;
}
```
