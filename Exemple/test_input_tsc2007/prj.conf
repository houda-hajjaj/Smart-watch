## CMakeLists.txt
```
# SPDX-License-Identifier: Apache-2.0

cmake_minimum_required(VERSION 3.10.0)

set(SHIELD adafruit_2_8_tft_touch_v2)

find_package(Zephyr REQUIRED HINTS $ENV{ZEPHYR_BASE})
project(test_input_tsc2007)

target_sources(app PRIVATE src/main.c)
```

## Kconfig
```
# Copyright (c) 2023 Synopsys.
#
# SPDX-License-Identifier: Apache-2.0

config SAMPLE_DO_OUTPUT
	bool "Do print from the main thread which can be checked"

# Pull in the TSC2007 Kconfig (not yet wired in upstream Zephyr)
rsource "$(ZEPHYR_BASE)/drivers/input/Kconfig.tsc2007"

source "Kconfig.zephyr"
```

## prj.conf
```kconfig
CONFIG_LOG=y

CONFIG_INPUT=y
CONFIG_I2C=y
CONFIG_INPUT_TSC2007=y

CONFIG_INPUT_LOG_LEVEL_INF=y

# Enable console and UART log backend so LOG_* outputs appear on serial
CONFIG_CONSOLE=y
CONFIG_UART_CONSOLE=y
CONFIG_LOG_BACKEND_UART=y
# Default log level (3 == INFO)
CONFIG_LOG_DEFAULT_LEVEL=3
```

## src/main.c
```c
/*
 * Copyright (c) 2019 Nordic Semiconductor ASA
 *
 * SPDX-License-Identifier: Apache-2.0
 */

 #include <zephyr/logging/log.h>
 #include <zephyr/kernel.h>
 #include <zephyr/device.h>
 #include <zephyr/input/input.h>
 #include <zephyr/sys/util.h>
#include <zephyr/sys/printk.h>
 
 LOG_MODULE_REGISTER(sample, LOG_LEVEL_INF);
 
 #define REFRESH_RATE 100
 
 static const struct device *const touch_dev = DEVICE_DT_GET(DT_NODELABEL(tsc2007_adafruit_2_8_tft_touch_v2));
 
 static struct k_sem sync;
 
 static struct {
	 size_t x;
	 size_t y;
	 bool pressed;
 } touch_point;
 
 static void touch_event_callback(struct input_event *evt, void *user_data)
 {
	 if (evt->code == INPUT_ABS_X) {
		 touch_point.x = evt->value;
	 }
	 if (evt->code == INPUT_ABS_Y) {
		 touch_point.y = evt->value;
	 }
	 if (evt->code == INPUT_BTN_TOUCH) {
		 touch_point.pressed = evt->value;
	 }
	 if (evt->sync) {
		 k_sem_give(&sync);
	 }
 }
 
 INPUT_CALLBACK_DEFINE(touch_dev, touch_event_callback, NULL);
 
 int main(void)
 {
    printk("boot\n");
	 LOG_INF("Touch sample for touchscreen: %s", touch_dev->name);
 
	 if (!device_is_ready(touch_dev)) {
		 LOG_ERR("Device %s not found. Aborting sample.", touch_dev->name);
		 return 0;
	 }
 
	 k_sem_init(&sync, 0, 1);
 
	 while (1) {
		 k_msleep(REFRESH_RATE);
		 k_sem_take(&sync, K_FOREVER);
		 LOG_INF("TOUCH %s X, Y: (%d, %d)", touch_point.pressed ? "PRESS" : "RELEASE",
			 touch_point.x, touch_point.y);
	 }
 
	 return 0;
 }
```
