## Nordic/ncs/v3.1.0/zephyr/drivers/input/Kconfig.tsc2007
```kconfig
# Copyright (c) 2025 Hervé Boeglen
# SPDX-License-Identifier: Apache-2.0

config INPUT_TSC2007
	bool "TSC2007 touch driver"
	default y
	depends on DT_HAS_TI_TSC2007_ENABLED
	select I2C
	select INPUT_TOUCH
	help
	  Enable driver for TSC2007 touch panel.
```

## Nordic/ncs/v3.1.0/zephyr/dts/bindings/input/ti,tsc2007.yaml
```yaml
# Copyright (c) 2020,2025 Hervé Boeglen
# SPDX-License-Identifier: Apache-2.0

description: TSC2007 Resistive touch panels

compatible: "ti,tsc2007"

include: [i2c-device.yaml, touchscreen-common.yaml]

properties:
  int-gpios:
    type: phandle-array
    description: |
      Interrupt GPIO. Used by the controller to signal touch data is
      available. Active low.
  raw-x-min:
    type: int
    description: |
      Signed raw X axis start for scaling the reported coordinates.
      No effect if screen size is not set.

  raw-y-min:
    type: int
    description: |
      Signed raw Y axis start for scaling the reported coordinates.
      No effect if screen size is not set.

  raw-x-max:
    type: int
    description: |
      Raw X axis end for scaling the reported coordinates.
      No effect if screen size is not set.

  raw-y-max:
    type: int
    description: |
      Raw Y axis end for scaling the reported coordinates.
      No effect if screen size is not set.   
      
  inverted-x:
    type: boolean
    description: X axis is inverted.
      
  inverted-y:
    type: boolean
    description: Y axis is inverted.
```
